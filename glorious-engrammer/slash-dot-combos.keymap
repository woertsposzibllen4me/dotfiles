   combo_forward_slash_dot {
      timeout-ms = <COMBO_FIRING_DECAY>;
      key-positions = <POS_LH_T1 POS_LH_T4>;
      bindings = <&macro_forward_slash_dot>;
      layers = <19>;  // Replace with your symbol layer number if needed
  }; 

  combo_dot_backslash {
      timeout-ms = <COMBO_FIRING_DECAY>;
      key-positions = <POS_LH_T1 POS_LH_T4>;
      bindings = <&dot_backslash>
      layers = <19>;  // Replace with your symbol layer number if needed
  };

  ZMK_MACRO(dot_backslash,
      wait-ms = <0>;
      tap-ms = <0>;
      bindings = <&kp DOT &kp BSLH>;
  )
