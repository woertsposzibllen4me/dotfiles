      #ifdef LAYER_Cursor
      Cursor {
        bindings = <
          ___ ___ ___ ___ ___                                             ___ ___ ___ ___ ___
          ___ COR COR COR COR ___                                     ___ ___ ___ ___ ___ ___
          ___ COR COR COR COR GDN                                     ___ COR PUR PUR TEA COR
          YLW MAJ CYN GRN YLW GDN                                     AZU AZU AZU AZU PNK YLW
          PNK SPG SPG SPG PUR GDN     COR COR ___     SPG SPG SPG     ___ AZU AZU AZU AZU PNK
          PNK PUR PUR PUR PUR         RED ___ ___     SPG SPG SPG         PUR PUR PUR PUR PNK
        >;
        layer-id = <LAYER_Cursor>;
      };
      #endif
